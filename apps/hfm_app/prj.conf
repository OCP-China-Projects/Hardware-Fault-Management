## CMakeLists.txt
```
cmake_minimum_required(VERSION 3.20.0)

find_package(Zephyr REQUIRED HINTS $ENV{ZEPHYR_BASE})
project(hfm_app LANGUAGES C)

target_sources(app PRIVATE src/main.c)
```

## prj.conf
```kconfig
# HFM app baseline config
CONFIG_MAIN_STACK_SIZE=4096
CONFIG_SYSTEM_WORKQUEUE_STACK_SIZE=4096

# Console / printk / log
CONFIG_PRINTK=y
CONFIG_LOG=y
CONFIG_LOG_MODE_IMMEDIATE=y

# Shell (interactive debug on UART)
CONFIG_SHELL=y
CONFIG_SHELL_BACKEND_SERIAL=y

# Placeholders — enable once the board devicetree exposes an I3C controller.
# CONFIG_I3C=y
# CONFIG_I3C_SHELL=y
```

## app.overlay
```dts
/*
 * HFM devicetree overlay.
 *
 * Reserves a place for I3C-related nodes. On sifive_u the SoC has no
 * I3C controller in-tree, so this overlay only wires up the console
 * for now. Add I3C nodes here when a controller becomes available:
 *
 *   &i3c0 {
 *       status = "okay";
 *       hfm_target: hfm_target@70 {
 *           compatible = "hfm,target";
 *           reg = <0x70 0 0>;
 *       };
 *   };
 */

/ {
    chosen {
        zephyr,console = &uart0;
        zephyr,shell-uart = &uart0;
    };
};
```

## src/main.c
```c
#include <zephyr/kernel.h>
#include <zephyr/sys/printk.h>
#include <zephyr/logging/log.h>

LOG_MODULE_REGISTER(hfm, LOG_LEVEL_INF);

#define HFM_HEARTBEAT_INTERVAL K_SECONDS(1)

int main(void)
{
    printk("HFM app boot on %s\n", CONFIG_BOARD);
    LOG_INF("hfm main thread started");

    uint32_t tick = 0;
    while (1) {
        LOG_INF("heartbeat #%u", tick++);
        k_sleep(HFM_HEARTBEAT_INTERVAL);
    }
    return 0;
}
```
